## idf/main/Kconfig.projbuild
```kconfig
menu "Plane Radar display"

config EXAMPLE_DOUBLE_FB
    bool "Use ESP-IDF RGB panel double frame buffers"
    default n
    help
        Let the ESP-IDF RGB driver own two complete frame buffers in PSRAM.
        LVGL draws directly into the inactive buffer and the driver switches
        buffers at refresh, avoiding application-managed copies.

config RADAR_LVGL_PSRAM_DOUBLE_BUFFER
    bool "Deprecated full-screen LVGL PSRAM rendering"
    default n
    help
        Retained for existing sdkconfig files. Full-screen PSRAM rendering is
        not used because it can starve RGB scan-out on this panel.

config RADAR_RGB_BOUNCE_BUFFER
    bool "Use ESP-IDF RGB bounce buffers"
    default y
    help
        Stages RGB scan-out rows in internal DMA RAM. This prevents PSRAM
        activity from Wi-Fi or LVGL updates from starving the LCD peripheral.

endmenu
```

## idf/sdkconfig.defaults
```kconfig
CONFIG_SPIRAM=y
CONFIG_SPIRAM_MODE_OCT=y
CONFIG_SPIRAM_SPEED_80M=y
CONFIG_SPIRAM_FETCH_INSTRUCTIONS=y
CONFIG_SPIRAM_RODATA=y
CONFIG_LV_MEM_CUSTOM=y
CONFIG_LV_MEMCPY_MEMSET_STD=y
# CONFIG_EXAMPLE_DOUBLE_FB is not set
# CONFIG_RADAR_LVGL_PSRAM_DOUBLE_BUFFER is not set
CONFIG_RADAR_RGB_BOUNCE_BUFFER=y
CONFIG_ESPTOOLPY_FLASHSIZE_16MB=y
CONFIG_PARTITION_TABLE_CUSTOM=y
CONFIG_PARTITION_TABLE_CUSTOM_FILENAME="../partitions/plane_radar.csv"
```

## sdkconfig.defaults
```kconfig
CONFIG_IDF_TARGET="esp32s3"
CONFIG_ESP32S3_SPIRAM_SUPPORT=y
CONFIG_SPIRAM=y
CONFIG_SPIRAM_MODE_OCT=y
CONFIG_SPIRAM_SPEED_80M=y
CONFIG_SPIRAM_FETCH_INSTRUCTIONS=y
CONFIG_SPIRAM_RODATA=y
CONFIG_SPIRAM_USE_MALLOC=y
CONFIG_SPIRAM_MALLOC_ALWAYSINTERNAL=16384
CONFIG_SPIRAM_MALLOC_RESERVE_INTERNAL=32768
CONFIG_PARTITION_TABLE_CUSTOM=y
CONFIG_PARTITION_TABLE_CUSTOM_FILENAME="partitions/plane_radar.csv"
CONFIG_AUTOSTART_ARDUINO=n
```
